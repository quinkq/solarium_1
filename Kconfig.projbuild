## components/core/impluvium/Kconfig
```kconfig
menu "IMPLUVIUM Irrigation System Configuration"

    config IMPLUVIUM_DRY_TEST_MODE
        bool "Enable Dry Test Mode (Bypass Safety Checks)"
        default n
        help
            When enabled, bypasses critical safety checks for dry test runs:
            - Water level check: Returns fixed 50% level
            - Outlet pressure check: Returns fixed 0.5 bar (safe range)
            - Flow rate check: Bypassed during periodic safety monitoring
            
            Note: Temperature checks still use real TEMPESTA sensor.
            
            This is a compile-time flag - rebuild after changing.

endmenu
```

## components/core/telemetry/Kconfig
```kconfig
menu "TELEMETRY MQTT Configuration"

    config TELEMETRY_MQTT_ENABLE
        bool "Enable MQTT client"
        default y
        help
            Enable MQTT client for telemetry data transmission.
            Disable this for testing without a broker to reduce log spam.

    config TELEMETRY_MQTT_BROKER_URI
        string "MQTT Broker URI"
        default "mqtt://192.168.1.100:1883"
#        depends on TELEMETRY_MQTT_ENABLE
        help
            URI of the MQTT broker (e.g., mqtt://broker.example.com:1883 or mqtts://broker.example.com:8883 for TLS)

    config TELEMETRY_MQTT_USERNAME
        string "MQTT Username"
        default "solarium"
#        depends on TELEMETRY_MQTT_ENABLE
        help
            Username for MQTT broker authentication

    config TELEMETRY_MQTT_PASSWORD
        string "MQTT Password"
        default "password"
#        depends on TELEMETRY_MQTT_ENABLE
        help
            Password for MQTT broker authentication

    config TELEMETRY_MQTT_CLIENT_ID
        string "MQTT Client ID"
        default "solarium_esp32"
#        depends on TELEMETRY_MQTT_ENABLE
        help
            Unique client identifier for this ESP32 device

endmenu
```
